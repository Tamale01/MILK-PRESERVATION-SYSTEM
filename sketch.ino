#include <DHT.h>
#include <Wire.h>
#include <LiquidCrystal_I2C.h>

// ----- Pin definitions -----
#define DHTPIN 4
#define DHTTYPE DHT22

#define RED_PIN 26
#define GREEN_PIN 27
#define BLUE_PIN 14

#define RELAY_PIN 33
#define BUZZER_PIN 25

// ----- Temperature thresholds (adjusted for milk preservation) -----
#define TOO_COLD 2        // Γëñ 2┬░C
#define SAFE_MAX 5        // 3┬░C ΓÇô 5┬░C safe range
#define CRITICAL_TEMP 8   // > 8┬░C critical

// ----- Humidity thresholds (unchanged from your original) -----
#define LOW_HUMIDITY 70
#define MODERATE_HUMIDITY 79
#define OPTIMAL_HUMIDITY_MIN 80
#define OPTIMAL_HUMIDITY_MAX 90
#define HIGH_HUMIDITY 95

// ----- Objects -----
DHT dht(DHTPIN, DHTTYPE);
LiquidCrystal_I2C lcd(0x27, 16, 2);

void setup() {
  Serial.begin(115200);

  dht.begin();

  lcd.init();
  lcd.backlight();

  pinMode(RED_PIN, OUTPUT);
  pinMode(GREEN_PIN, OUTPUT);
  pinMode(BLUE_PIN, OUTPUT);
  pinMode(RELAY_PIN, OUTPUT);
  pinMode(BUZZER_PIN, OUTPUT);
}

void loop() {

  float temp = dht.readTemperature();
  float hum = dht.readHumidity();

  if (isnan(temp) || isnan(hum)) {
    Serial.println("Sensor Error!");

    lcd.clear();
    lcd.setCursor(0, 0);
    lcd.print("Sensor Failure");

    digitalWrite(RED_PIN, LOW);
    digitalWrite(GREEN_PIN, LOW);
    digitalWrite(BLUE_PIN, LOW);
    digitalWrite(RELAY_PIN, LOW);
    digitalWrite(BUZZER_PIN, LOW);

    delay(2000);
    return;
  }

  lcd.clear();
  lcd.setCursor(0, 0);
  lcd.print("T:");
  lcd.print(temp);
  lcd.print("C");

  lcd.setCursor(9, 0);
  lcd.print("H:");
  lcd.print(hum);
  lcd.print("%");

  // ===== TEMPERATURE PRIORITY =====
  if (temp <= TOO_COLD) {

    // BLUE
    digitalWrite(RED_PIN, LOW);
    digitalWrite(GREEN_PIN, LOW);
    digitalWrite(BLUE_PIN, HIGH);

    digitalWrite(RELAY_PIN, LOW);
    digitalWrite(BUZZER_PIN, HIGH);

    lcd.setCursor(0, 1);
    lcd.print("TOO COLD");

  }

  else if (temp > SAFE_MAX && temp <= CRITICAL_TEMP) {

    // RED
    digitalWrite(RED_PIN, HIGH);
    digitalWrite(GREEN_PIN, LOW);
    digitalWrite(BLUE_PIN, LOW);

    digitalWrite(RELAY_PIN, HIGH);
    digitalWrite(BUZZER_PIN, HIGH);

    lcd.setCursor(0, 1);
    lcd.print("TOO HOT");

  }

  else if (temp > CRITICAL_TEMP) {

    // FLASHING RED
    digitalWrite(RED_PIN, HIGH);
    digitalWrite(GREEN_PIN, LOW);
    digitalWrite(BLUE_PIN, LOW);

    digitalWrite(RELAY_PIN, HIGH);
    digitalWrite(BUZZER_PIN, HIGH);

    delay(500);

    digitalWrite(RED_PIN, LOW);

    delay(500);

    lcd.setCursor(0, 1);
    lcd.print("CRITICAL TEMP");

  }

  // ===== HUMIDITY CHECKS ONLY IF TEMP SAFE =====
  else {

    if (hum < LOW_HUMIDITY) {

      // YELLOW = RED + GREEN
      digitalWrite(RED_PIN, HIGH);
      digitalWrite(GREEN_PIN, HIGH);
      digitalWrite(BLUE_PIN, LOW);

      digitalWrite(RELAY_PIN, LOW);
      digitalWrite(BUZZER_PIN, LOW);

      lcd.setCursor(0, 1);
      lcd.print("LOW HUMID");

    }

    else if (hum >= OPTIMAL_HUMIDITY_MIN && hum <= OPTIMAL_HUMIDITY_MAX) {

      // CYAN = GREEN + BLUE
      digitalWrite(RED_PIN, LOW);
      digitalWrite(GREEN_PIN, HIGH);
      digitalWrite(BLUE_PIN, HIGH);

      digitalWrite(RELAY_PIN, LOW);
      digitalWrite(BUZZER_PIN, LOW);

      lcd.setCursor(0, 1);
      lcd.print("SAFE");

    }

    else if (hum > OPTIMAL_HUMIDITY_MAX && hum <= HIGH_HUMIDITY) {

      // PURPLE = RED + BLUE
      digitalWrite(RED_PIN, HIGH);
      digitalWrite(GREEN_PIN, LOW);
      digitalWrite(BLUE_PIN, HIGH);

      digitalWrite(RELAY_PIN, LOW);
      digitalWrite(BUZZER_PIN, HIGH);

      lcd.setCursor(0, 1);
      lcd.print("HIGH HUMID");

    }

    else if (hum > HIGH_HUMIDITY) {

      // FLASH PURPLE/RED
      digitalWrite(RED_PIN, HIGH);
      digitalWrite(BLUE_PIN, HIGH);
      digitalWrite(GREEN_PIN, LOW);

      digitalWrite(RELAY_PIN, HIGH);
      digitalWrite(BUZZER_PIN, HIGH);

      delay(500);

      digitalWrite(RED_PIN, LOW);
      digitalWrite(BLUE_PIN, LOW);

      delay(500);

      lcd.setCursor(0, 1);
      lcd.print("CRIT HUMID");

    }

  }

  delay(2000);
}
